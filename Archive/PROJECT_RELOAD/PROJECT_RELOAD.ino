//Including Liberys
#include <ESP8266WiFi.h>
#include <Wire.h>
#include <Adafruit_SSD1306.h>
#include <UniversalTelegramBot.h>
#include <WiFiClientSecure.h>
#include <ArduinoJson.h>

//WIFI Credentials
const char* ssid = "TEST";
const char* password = "TEST1234";
/*
//WIFI Credentials
const char* ssid = "WiFi Ki Tor Bap Er";
const char* password = "f0kirni007";
*/
// Initialize Telegram BOT
#define BOTtoken "6593502902:AAGsV9AvosqFBzgwKxPCRg5e3LJEUvowzmk"
#define CHAT_ID "6348432516"
#ifdef ESP8266
  X509List cert(TELEGRAM_CERTIFICATE_ROOT);
#endif

WiFiClientSecure client;
UniversalTelegramBot bot(BOTtoken, client);

// Checks for new messages every 1 second.
int botRequestDelay = 1000;
unsigned long lastTimeBotRan;



//defining Variables

#define SCREEN_WIDTH 128 // OLED DISPLAY WIDTH, IN PIXELS
#define SCREEN_HEIGHT 64 // OLED DISPLAY HEIGHT, IN PIXELS
#define OLED_RESET  -1 //RESET PIN 


//VARIABLE FOR LIBERY
Adafruit_SSD1306 display(SCREEN_WIDTH, SCREEN_HEIGHT, &Wire, OLED_RESET);



void setup(){

  //initing serial montitor.
  Serial.begin(115200);
 // SSD1306_SWITCHCAPVCC = generate display voltage from 3.3V internally
  if(!display.begin(SSD1306_SWITCHCAPVCC, 0x3C)) { 
    Serial.println(F("SSD1306 allocation failed"));
    for(;;); // Don't proceed, loop forever
  }

  delay(20);
  //Showing inting thigs
  display.clearDisplay();
  logo();
  delay(10000);
  display.clearDisplay();
  creator();
  delay(5000);
  display.clearDisplay();  
  Serial.println("WELCOME SHOURAV");
  display.setTextSize(3);
  display.setCursor(0, 10);
  display.setTextColor(WHITE);
  display.println("WELCOME");
  display.display();
  display.setCursor(0, 40);
  display.println("SHOURAV");
  display.display();
  delay(4000);
  cle();

   // Connect to Wi-Fi
  WiFi.mode(WIFI_STA);
  WiFi.begin(ssid, password);

  #ifdef ESP32
    client.setCACert(TELEGRAM_CERTIFICATE_ROOT); // Add root certificate for api.telegram.org
  #endif
  while (WiFi.status() != WL_CONNECTED) {
    res();
    display.println("Connecting To WIFI");
    display.setTextSize(2);
    display.setCursor(0, 10);
    display.println("....");
    display.display();
    delay(1000);
    cle();
    Serial.println("Connecting to WiFi..");
    res();
    display.println("Connecting To WIFI");
    display.setTextSize(2);
    display.setCursor(0, 10);
    display.println("........");
    display.display();
    delay(1000);
    cle();
  }
  
  // Print ESP32 Local IP Address
  Serial.println(WiFi.localIP());
  res();
  display.setTextSize(2); 
  display.println("LOCAL IP :");
  display.setCursor(0, 20);
  display.println(WiFi.localIP());
  display.display();
  delay(4000);
    
    
  #ifdef ESP8266
    configTime(0, 0, "time.google.com");      // get UTC time via NTP
    client.setTrustAnchors(&cert); // Add root certificate for api.telegram.org
  #endif
  ///SENDING ONLINE MASSAGE
  String welcome = "Hey, Shourav.\n";
  welcome += "Just Saying I am online.\n\n";
  bot.sendMessage(CHAT_ID, welcome, "");

  res();
  cle();

}

void loop(){
  //This part will handel incoming request in loop
  if (millis() > lastTimeBotRan + botRequestDelay)  {
    int numNewMessages = bot.getUpdates(bot.last_message_received + 1);

    while(numNewMessages) {
      Serial.println("got response");
      handleNewMessages(numNewMessages);
      numNewMessages = bot.getUpdates(bot.last_message_received + 1);
    }
    lastTimeBotRan = millis();
  }






  ///THISH WILL RECONNECT IF DISCONNECTED
  if (WiFi.status() != WL_CONNECTED){
    wf_con();
  }


  
}


/////////////////////////////
//function to clear display
void cle(){
  display.clearDisplay();
  display.display();
}
/////////////////////////////////////
//function to reset display settings
void res(){
  display.setTextSize(1);
  display.setCursor(0, 0);
}





///////////////////////////////////////////////////
// Handle what happens when you receive new messages
void handleNewMessages(int numNewMessages) {
  Serial.println("handleNewMessages");
  Serial.println(String(numNewMessages));

  for (int i=0; i<numNewMessages; i++) {
    // Chat id of the requester
    String chat_id = String(bot.messages[i].chat_id);
    if (chat_id != CHAT_ID){
      bot.sendMessage(chat_id, "Unauthorized user", "");
      continue;
    }
    
    // Print the received message
    String text = bot.messages[i].text;
    Serial.println(text);

    String from_name = bot.messages[i].from_name;
    String IP = WiFi.localIP().toString();

    if (text == "/start" || text == "/help") {
      String welcome = "Welcome, " + from_name + ".\n";
      welcome += "Use the following commands Can Be Execute Via RELOAD.\n\n";
      welcome += "/ip To Show Loacal IP. \n";
      welcome += "/on To Turn On Laptop. \n";
      bot.sendMessage(chat_id, welcome, "");
    }
    //BOT IP FUNCTION
    if (text == "/ip" || text == "/Ip" || text == "/IP") {
      
      String message= "RELOAD IP: " + IP + "\n";
      bot.sendMessage(chat_id, message, "");
      show_ip();
      cle();
    }
    //BOT PC ON
    if (text == "/on" || text == "/On" || text == "/ON") {
      String message= "COMMAND RECIVED.\n";
      message += "Truning On Laptop.\n";
      bot.sendMessage(chat_id, message, "");
      res();
      cle();
      display.setTextSize(2);
      display.print("INITING");
      display.setCursor(0, 20);
      display.println("Command"); 
      display.display();
      //delay(10000);
      
      String message1 = " Command Executed.";
      bot.sendMessage(chat_id, message1, "");
      cle();
      display.println("DONE.(*_*)");
      display.display();
      delay(5000);
      res();
      cle();
    }
    //BOT PC OFF
    if (text == "/off" || text == "/Off" || text == "/OFF") {
      String message= "COMMAND RECIVED.\n";
      message += "Truning OFF Laptop.\n";
      bot.sendMessage(chat_id, message, "");
      res();
      cle();
      display.setTextSize(2);
      display.print("INITING");
      display.setCursor(0, 20);
      display.println("Command"); 
      display.display();
      //delay(10000);
      
      String message1 = " Command Executed.";
      bot.sendMessage(chat_id, message1, "");
      cle();
      display.println("DONE.(*_*)");
      display.display();
      delay(5000);
      res();
      cle();
    }
    
    if (text == "/state") {
      //if (digitalRead(ledPin)){
        //bot.sendMessage(chat_id, "LED is ON", "");
      //}
      //else{
        //bot.sendMessage(chat_id, "LED is OFF", "");
      //}
    }
  }
}



////////////////////////////////
//Function that will show ip:
void show_ip(){
  // Print ESP32 Local IP Address
  Serial.println(WiFi.localIP());
  res();
  display.setTextSize(2); 
  display.println("LOCAL IP :");
  display.setCursor(0, 20);
  display.println(WiFi.localIP());
  display.display();
  delay(10000);
}

//THIS WILL CONNECT TO WIFI IF DISCONNECTED
void wf_con(){
  
    while (WiFi.status() != WL_CONNECTED) {
    res();
    display.println("Connecting To WIFI");
    display.setTextSize(2);
    display.setCursor(0, 10);
    display.println("....");
    display.display();
    delay(1000);
    cle();
    Serial.println("Connecting to WiFi..");
    res();
    display.println("Connecting To WIFI");
    display.setTextSize(2);
    display.setCursor(0, 10);
    display.println("........");
    display.display();
    delay(1000);
    cle();}
  ///Sending alart messge 
    String welcome = "Hey, Shourav.\n";
    welcome += "Some How Got Knocked You From WiFi.\n\n";
    bot.sendMessage(CHAT_ID, welcome, "");
    show_ip();
    cle();
  
  }
   
  void logo(){
    
static const uint8_t logo[1024] = {
  
    0xff, 0xff, 0xff, 0xff, 0xff, 0xff, 0xff, 0xff, 0xff, 0xff, 0xff, 0xff, 0xff, 0xff, 0xff, 0xff, 
    0xff, 0xff, 0xff, 0xff, 0xff, 0xff, 0xff, 0xff, 0xff, 0xff, 0xff, 0xff, 0xff, 0xff, 0xff, 0xff, 
    0xff, 0xff, 0xff, 0xff, 0xff, 0xff, 0xff, 0xfc, 0x00, 0x00, 0x3f, 0xff, 0xff, 0xff, 0xff, 0xff, 
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    0xff, 0xff, 0xff, 0xff, 0xff, 0xff, 0xff, 0xff, 0xff, 0xff, 0xff, 0xff, 0xff, 0xff, 0xff, 0xff

};
     
  // Draw bitmap on the screen
  display.drawBitmap(0, 0, logo, 128, 64, 1);
  display.display();
    
  }

void creator() {
  
static const uint8_t logo[1024] = {
0xff, 0xff, 0xff, 0xff, 0xff, 0xff, 0x80, 0x00, 0x00, 0x00, 0x00, 0x7f, 0xff, 0xff, 0xff, 0xff, 
    0xff, 0xff, 0xff, 0xff, 0xff, 0xff, 0xc0, 0x00, 0x00, 0x00, 0x00, 0x3f, 0xff, 0xff, 0xff, 0xff, 
    0xff, 0xff, 0xff, 0xff, 0xff, 0xbb, 0xc0, 0x00, 0x00, 0x00, 0x00, 0x03, 0xff, 0xff, 0xff, 0xff, 
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    0xff, 0xff, 0xff, 0xf0, 0x00, 0x00, 0x00, 0x00, 0x00, 0x00, 0x00, 0x00, 0x00, 0x1f, 0xff, 0xff
  
};
  // Clear the buffer.
  display.clearDisplay();
  
  // Draw bitmap on the screen
  display.drawBitmap(0, 0, logo, 128, 64, 1);
  display.display();
 
}